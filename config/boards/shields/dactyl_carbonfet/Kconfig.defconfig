## config/boards/shields/dactyl_carbonfet/Kconfig.defconfig
```kconfig
if SHIELD_DACTYL_CARBONFET_LEFT

config ZMK_KEYBOARD_NAME
	default "Dactyl Carbonfet"

config ZMK_SPLIT_ROLE_CENTRAL
	default y

endif

if SHIELD_DACTYL_CARBONFET_LEFT || SHIELD_DACTYL_CARBONFET_RIGHT

config ZMK_SPLIT
	default y

endif
```

## config/boards/shields/dactyl_carbonfet/Kconfig.shield
```kconfig
config SHIELD_DACTYL_CARBONFET_LEFT
	def_bool $(shields_list_contains, dactyl_carbonfet_left)

config SHIELD_DACTYL_CARBONFET_RIGHT
	def_bool $(shields_list_contains, dactyl_carbonfet_right)
```
